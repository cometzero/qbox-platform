/dts-v1/;
/plugin/;

/ {
    fragment@0 {
        target-path = "/soc/interrupt-controller@20800000/msi-controller@20840000";

        pcie_irq_its: __overlay__ {
        };
    };

    fragment@1 {
        target-path = "/soc";

        __overlay__ {
            #address-cells = <0x2>;
            #size-cells = <0x2>;

            pcie_irq_smmu: smmu@1c0000000 {
                compatible = "arm,smmu-v3";
                reg = <0x1 0xc0000000 0x0 0x20000>;
                interrupt-parent = <&gic>;
                interrupts = <0x0 0x41 0x4>;
                #iommu-cells = <0x1>;
                dma-coherent;
            };

            pcie@43b50000 {
                compatible = "pci-host-ecam-generic";
                device_type = "pci";
                #address-cells = <0x3>;
                #size-cells = <0x2>;
                #interrupt-cells = <0x1>;
                bus-range = <0x0 0xff>;
                reg = <0x0 0x43b50000 0x0 0x10000000>;
                dma-coherent;

                ranges =
                    <0x01000000 0x0 0x0
                     0x0 0x60200000
                     0x0 0x00100000>,
                    <0x02000000 0x0 0x60300000
                     0x0 0x60300000
                     0x0 0x1fd00000>,
                    <0x03000000 0x4 0x0
                     0x4 0x0
                     0x2 0x0>;

                iommu-map = <0x8 &pcie_irq_smmu 0x40 0x1>;
                iommu-map-mask = <0xffff>;
                msi-map = <0x8 &pcie_irq_its 0x8 0x1>;
                msi-map-mask = <0xffff>;

                /*
                 * The opt-in endpoint is 0000:00:01.0. GPEX swizzles its
                 * INTA-D pins to outputs 1, 2, 3, 0 respectively.
                 */
                interrupt-map-mask = <0xf800 0x0 0x0 0x7>;
                interrupt-map =
                    <0x800 0x0 0x0 0x1 &gic
                     0x0 0x0 0x0 0x12d 0x4>,
                    <0x800 0x0 0x0 0x2 &gic
                     0x0 0x0 0x0 0x12e 0x4>,
                    <0x800 0x0 0x0 0x3 &gic
                     0x0 0x0 0x0 0x12f 0x4>,
                    <0x800 0x0 0x0 0x4 &gic
                     0x0 0x0 0x0 0x12c 0x4>;
            };
        };
    };
};
