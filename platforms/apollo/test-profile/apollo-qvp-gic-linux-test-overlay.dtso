/dts-v1/;
/plugin/;

/ {
	fragment@0 {
		target-path = "/";

		__overlay__ {
			gic720ae-linux-selftest {
				compatible = "arm,gic720ae-linux-selftest";
				interrupts = <0 54 1>;
				status = "okay";
			};
		};
	};
};
